## arch/arm/configs/virt_defconfig
```kconfig
CONFIG_ARCH_VIRT=y
CONFIG_BAREBOX_MAX_IMAGE_SIZE=0x05000000
CONFIG_AEABI=y
CONFIG_ARM_OPTIMZED_STRING_FUNCTIONS=y
CONFIG_MMU=y
# CONFIG_MMU_EARLY is not set
CONFIG_BAREBOX_MAX_BARE_INIT_SIZE=0x01000000
CONFIG_MEMORY_LAYOUT_FIXED=y
CONFIG_STACK_BASE=0x60000000
CONFIG_MALLOC_BASE=0x50000000
CONFIG_PROMPT="virt: "
CONFIG_HUSH_FANCY_PROMPT=y
CONFIG_CMDLINE_EDITING=y
CONFIG_AUTO_COMPLETE=y
CONFIG_MENU=y
CONFIG_PASSWORD=y
CONFIG_PARTITION=y
CONFIG_DEFAULT_ENVIRONMENT_GENERIC_NEW=y
CONFIG_DEFAULT_ENVIRONMENT_PATH="arch/arm/boards/virt/env"
CONFIG_DEBUG_INFO=y
CONFIG_LONGHELP=y
# CONFIG_CMD_BOOTM is not set
# CONFIG_CMD_BOOTU is not set
# CONFIG_CMD_MOUNT is not set
# CONFIG_CMD_UMOUNT is not set
# CONFIG_CMD_CAT is not set
# CONFIG_CMD_CD is not set
# CONFIG_CMD_CP is not set
# CONFIG_CMD_LS is not set
# CONFIG_CMD_MKDIR is not set
# CONFIG_CMD_PWD is not set
# CONFIG_CMD_RM is not set
# CONFIG_CMD_RMDIR is not set
# CONFIG_CMD_FALSE is not set
# CONFIG_CMD_TEST is not set
# CONFIG_CMD_TRUE is not set
# CONFIG_CMD_CLEAR is not set
# CONFIG_CMD_ECHO is not set
CONFIG_CMD_CRC=y
CONFIG_CMD_CRC_CMP=y
# CONFIG_CMD_MD is not set
# CONFIG_CMD_MEMCMP is not set
# CONFIG_CMD_MEMCPY is not set
# CONFIG_CMD_MEMSET is not set
# CONFIG_CMD_MW is not set
CONFIG_SERIAL_AMBA_PL011=y
# CONFIG_SPI is not set
CONFIG_MTD=y
CONFIG_DRIVER_CFI=y
CONFIG_DRIVER_CFI_BANK_WIDTH_8=y
CONFIG_CFI_BUFFER_WRITE=y
CONFIG_NAND=y
# CONFIG_FS_RAMFS is not set
CONFIG_DIGEST_SHA1_GENERIC=y
CONFIG_DIGEST_SHA256_GENERIC=y
```

## arch/arm/mach-sunxi/Kconfig
```kconfig
if ARCH_SUNXI

config ARCH_TEXT_BASE
	hex
	default 0x40000000

choice
	prompt "ARM Board type"

config MACH_SUNXI50
	bool "A64 machine"
	select CPU_V8
	select SYS_SUPPORTS_64BIT_KERNEL
	select ARM_AMBA
	select HAVE_CONFIGURABLE_MEMORY_LAYOUT

endchoice
endif
```

## arch/arm64/Kconfig
```kconfig
config ARM
	bool
	select HAS_KALLSYMS
	select HAS_MODULES
	select HAS_DMA
	select HAS_CACHE
	select HAVE_CONFIGURABLE_TEXT_BASE
	select HAVE_PBL_IMAGE
	select HAVE_IMAGE_COMPRESSION
	default y

config ARM_LINUX
	bool
	default y
	depends on CMD_BOOTZ || CMD_BOOTU || BOOTM

config HAVE_MACH_ARM_HEAD
	bool

config ARM_USE_COMPRESSED_DTB
	bool
	select UNCOMPRESS
	select LZO_DECOMPRESS

config ARCH_BCM283X
	bool
	select GPIOLIB
	select CLKDEV_LOOKUP
	select COMMON_CLK
	select CLOCKSOURCE_BCM283X
	select ARM_AMBA
	select HAS_DEBUG_LL

menu "System Type"

config BUILTIN_DTB
	bool "link a DTB into the barebox image"
	depends on OFTREE
	depends on !HAVE_PBL_MULTI_IMAGES

config BUILTIN_DTB_NAME
	string "DTB to build into the barebox image"
	depends on BUILTIN_DTB
	default "canon-a1100" if MACH_CANON_A1100
	default "imx51-genesi-efika-sb" if MACH_EFIKA_MX_SMARTBOOK
	default "versatile-pb" if ARCH_VERSATILE_PB
	default "virt2real" if MACH_VIRT2REAL
	default "module-mb7707" if MACH_MB7707

choice
	prompt "ARM system type"

config ARCH_VEXPRESS
	bool "ARM Vexpres boards"
	select HAS_DEBUG_LL
#	select CPU_V7
	select CPU_V8
	select SYS_SUPPORTS_64BIT_KERNEL
	select ARM_AMBA
	select AMBA_SP804
	select CLKDEV_LOOKUP
	select COMMON_CLK

endchoice

source arch/arm64/cpu/Kconfig
source arch/arm64/mach-vexpress/Kconfig

config ARM_ASM_UNIFIED
	bool

config AEABI
	bool "Use the ARM EABI to compile barebox"
	help
	  This option allows for barebox to be compiled using the latest
	  ARM ABI (aka EABI).

	  To use this you need GCC version 4.0.0 or later.

config THUMB2_BAREBOX
	select ARM_ASM_UNIFIED
	select AEABI
	depends on !ARCH_TEGRA && !ARCH_AT91
	depends on CPU_V7 && !CPU_32v4T && !CPU_32v5 && !CPU_32v6
	bool "Compile barebox in thumb-2 mode (read help)"
	help
	  This enables compilation of barebox in thumb-2 mode which generates
	  ~25% smaller binaries. ARM assembly code needs some fixups to be able
	  to work correctly in thumb-2 mode. the barebox core should have these
	  fixups since most assembly code is derived from the Kernel. However,
	  your board lowlevel init code may break in thumb-2 mode. You have been
	  warned.

config ARM_BOARD_APPEND_ATAG
	bool "Let board specific code to add ATAGs to be passed to the kernel"
	depends on ARM_LINUX
	help
	  This option is purely to start some vendor provided kernels.
	  ** DO NOT USE FOR YOUR OWN DESIGNS! **

endmenu

choice
	prompt "Barebox code model"
	help
	  You should only select this option if you have a workload that
	  actually benefits from 64-bit processing or if your machine has
	  large memory. You will only be presented a single option in this
	  menu if your system does not support both 32-bit and 64-bit modes.

config 32BIT
	bool "32-bit barebox"
	depends on CPU_SUPPORTS_32BIT_KERNEL && SYS_SUPPORTS_32BIT_KERNEL
	help
	  Select this option if you want to build a 32-bit barebox.

config 64BIT
	bool "64-bit barebox"
	depends on CPU_SUPPORTS_64BIT_KERNEL && SYS_SUPPORTS_64BIT_KERNEL
	select ARCH_DMA_ADDR_T_64BIT
	help
	  Select this option if you want to build a 64-bit barebox.

endchoice

menu "ARM specific settings"

config ARM_OPTIMZED_STRING_FUNCTIONS
	bool "use assembler optimized string functions"
	help
	  Say yes here to use assembler optimized memcpy / memset functions.
	  These functions work much faster than the normal versions but
	  increase your binary size.

config ARM_EXCEPTIONS
	bool "enable arm exception handling support"
	default y

config ARM_UNWIND
	bool "enable stack unwinding support"
	depends on AEABI
	help
	  This option enables stack unwinding support in barebox
	  using the information automatically generated by the
	  compiler. The resulting kernel image is slightly bigger but
	  the performance is not affected. Currently, this feature
	  only works with EABI compilers. If unsure say Y.

config ARM_SEMIHOSTING
	bool "enable ARM semihosting support"
	help
	  This option enables ARM semihosting support in barebox. ARM
	  semihosting is a communication discipline that allows code
	  running on target ARM cpu perform system calls and access
	  the data on the host computer connected to the target via
	  debugging channel (JTAG, SWD). If unsure say N

endmenu

source common/Kconfig
source commands/Kconfig
source net/Kconfig
source drivers/Kconfig
source fs/Kconfig
source lib/Kconfig
source crypto/Kconfig
```

## arch/arm64/cpu/Kconfig
```kconfig
comment "Processor Type"

config CPU_64
	bool
	default y

# Select CPU types depending on the architecture selected. This selects
# which CPUs we support in the kernel image, and the compiler instruction
# optimiser behaviour.

# ARMv8
config CPU_V8
	bool
	select CPU_64v8
	select CPU_SUPPORTS_64BIT_KERNEL

config CPU_64v8
	bool

comment "processor features"

config ARCH_SUPPORTS_BIG_ENDIAN
	bool

config CPU_BIG_ENDIAN
	bool "Build big-endian kernel"
	depends on ARCH_SUPPORTS_BIG_ENDIAN
	help
	  Say Y if you plan on running a kernel in big-endian mode.
	  Note that your board must be properly built and your board
	  port must properly enable any big-endian related features
	  of your chipset/board/processor.

config BOOT_ENDIANNESS_SWITCH
	bool "Support switching of Linux kernel endianness"
	help
	  Say Y here if you need to switch CPU endianness before running
	  Linux kernel, e.g. if you want big-endian Barebox to run
	  little-endian Linux.

	  Currently implemented only by "bootz" command.

config SYS_SUPPORTS_32BIT_KERNEL
	bool

config SYS_SUPPORTS_64BIT_KERNEL
	bool

config CPU_SUPPORTS_32BIT_KERNEL
	bool

config CPU_SUPPORTS_64BIT_KERNEL
	bool
```

## arch/arm64/mach-virt/Kconfig
```kconfig
if ARCH_VIRT

config ARCH_TEXT_BASE
	hex
	default 0x40000000

choice
	prompt "ARM Board type"

config MACH_VIRT
	bool "ARM QEMU virt"

endchoice

endif
```
